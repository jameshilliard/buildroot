## package/python-nats-py/Config.in
```kconfig
config BR2_PACKAGE_PYTHON_NATS_PY
	bool "python-nats-py"
	help
	  NATS client for Python.

	  https://github.com/nats-io/nats.py
```

## package/python-nkeys/Config.in
```kconfig
config BR2_PACKAGE_PYTHON_NKEYS
	bool "python-nkeys"
	select BR2_PACKAGE_PYTHON_PYNACL # runtime
	help
	  A public-key signature system based on Ed25519 for the NATS
	  ecosystem.

	  https://github.com/nats-io/nkeys.py
```

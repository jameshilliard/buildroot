## boot/systemd-boot/Config.in
```kconfig
config BR2_TARGET_SYSTEMD_BOOT
	bool "systemd-boot"
	depends on BR2_i386 || BR2_x86_64
	depends on !BR2_PACKAGE_SYSTEMD
	select BR2_PACKAGE_GNU_EFI
	help
	  systemd-boot is a simple UEFI boot manager which executes
	  configured EFI images. The default entry is selected by a
	  configured pattern (glob) or an on-screen menu.

	  systemd-boot operates on the EFI System Partition (ESP)
	  only. Configuration file fragments, kernels, initrds, other
	  EFI images need to reside on the ESP. Linux kernels need to
	  be built with CONFIG_EFI_STUB to be able to be directly
	  executed as an EFI image.

	  See the Grub2 help text for details on preparing an EFI
	  capable disk image using systemd-boot: the instructions are
	  exactly the same, except that the systemd-boot configuration
	  files will be located in /loader/ inside the EFI partition.

	  https://www.freedesktop.org/wiki/Software/systemd/systemd-boot/

config BR2_TARGET_SYSTEMD_BOOT_EFI_ARCH
	string
	default "ia32"  if BR2_i386
	default "x64"   if BR2_x86_64
	depends on BR2_TARGET_SYSTEMD_BOOT

comment "systemd-boot is provided by systemd"
	depends on BR2_i386 || BR2_x86_64
	depends on BR2_PACKAGE_SYSTEMD
```

## configs/python_crypto_breaks_defconfig
```kconfig
BR2_x86_64=y
BR2_x86_corei7=y
BR2_TOOLCHAIN_EXTERNAL=y
BR2_TOOLCHAIN_EXTERNAL_BOOTLIN_X86_64_CORE_I7_GLIBC_STABLE=y
BR2_PACKAGE_CA_CERTIFICATES=y
BR2_PACKAGE_DOCKER_CLI=y
BR2_PACKAGE_DOCKER_COMPOSE=y
BR2_PACKAGE_DOCKER_ENGINE=y
BR2_TARGET_ROOTFS_EXT2=y
BR2_TARGET_ROOTFS_EXT2_SIZE="512M"
# BR2_TARGET_ROOTFS_TAR is not set
```

## configs/qt5_test_defconfig
```kconfig
BR2_aarch64=y
BR2_JLEVEL=16
BR2_CCACHE=y
# BR2_COMPILER_PARANOID_UNSAFE_PATH is not set
BR2_TOOLCHAIN_EXTERNAL=y
BR2_TOOLCHAIN_EXTERNAL_BOOTLIN=y
BR2_ROOTFS_DEVICE_CREATION_DYNAMIC_EUDEV=y
BR2_ROOTFS_MERGED_USR=y
# BR2_TARGET_GENERIC_GETTY is not set
BR2_SYSTEM_DEFAULT_PATH="/bin:/sbin:/usr/bin:/usr/sbin"
# BR2_ENABLE_LOCALE_PURGE is not set
BR2_PACKAGE_MESA3D=y
BR2_PACKAGE_MESA3D_GALLIUM_DRIVER_ETNAVIV=y
BR2_PACKAGE_MESA3D_OPENGL_GLX=y
BR2_PACKAGE_MESA3D_OPENGL_EGL=y
BR2_PACKAGE_MESA3D_OPENGL_ES=y
BR2_PACKAGE_QT5=y
BR2_PACKAGE_QT5BASE_LINUXFB=y
BR2_PACKAGE_QT5BASE_XCB=y
BR2_PACKAGE_QT5CONNECTIVITY=y
BR2_PACKAGE_QT5ENGINIO=y
BR2_PACKAGE_QT5LOCATION=y
BR2_PACKAGE_QT5MULTIMEDIA=y
BR2_PACKAGE_QT5SENSORS=y
BR2_PACKAGE_QT5SERIALPORT=y
BR2_PACKAGE_QT5SVG=y
BR2_PACKAGE_QT5WEBKIT=y
BR2_PACKAGE_QT5WEBENGINE=y
BR2_PACKAGE_QT5WEBENGINE_PROPRIETARY_CODECS=y
BR2_PACKAGE_QT5WEBENGINE_ALSA=y
BR2_PACKAGE_QT5XMLPATTERNS=y
BR2_PACKAGE_XORG7=y
BR2_PACKAGE_PYTHON3=y
BR2_PACKAGE_PYTHON_PYQT5=y
BR2_PACKAGE_JPEG=y
BR2_PACKAGE_BLUEZ5_UTILS=y
# BR2_PACKAGE_IFUPDOWN_SCRIPTS is not set
# BR2_PACKAGE_URANDOM_SCRIPTS is not set
# BR2_TARGET_ROOTFS_TAR is not set
```

## package/cloudflared/Config.in
```kconfig
config BR2_PACKAGE_CLOUDFLARED
	bool "cloudflared"
	depends on BR2_PACKAGE_HOST_GO_TARGET_ARCH_SUPPORTS
	help
	  Cloudflare Tunnel client (formerly Argo Tunnel).

	  https://github.com/cloudflare/cloudflared
```

## package/cmake-compat/Config.in.host
```kconfig
config BR2_PACKAGE_HOST_CMAKE_COMPAT
	bool "host cmake-compat"
	depends on !BR2_HOST_GCC_AT_LEAST_4_8
	help
	  CMake is an open-source, cross-platform family of tools
	  designed to build, test and package software. CMake is used
	  to control the software compilation process using simple
	  platform and compiler independent configuration files, and
	  generate native makefiles and workspaces that can be used in
	  the compiler environment of your choice.

	  This provides compatibility with toolchains that don't
	  support c++11.

	  http://www.cmake.org/
```

## package/cpuinfo/Config.in
```kconfig
config BR2_PACKAGE_CPUINFO
	bool "cpuinfo"
	help
	  CPU INFOrmation library, cpuinfo is a library to detect
	  essential for performance optimization information about
	  host CPU.

	  https://github.com/pytorch/cpuinfo
```

## package/libcupsfilters/Config.in
```kconfig
config BR2_PACKAGE_LIBCUPSFILTERS
	bool "libcupsfilters"
	# needs fork()
	depends on BR2_USE_MMU
	depends on BR2_INSTALL_LIBSTDCPP # qpdf
	depends on !BR2_STATIC_LIBS
	depends on BR2_PACKAGE_CUPS
	depends on BR2_TOOLCHAIN_GCC_AT_LEAST_5 # qpdf
	depends on BR2_TOOLCHAIN_HAS_ATOMIC # qpdf
	select BR2_PACKAGE_JPEG
	select BR2_PACKAGE_FONTCONFIG
	select BR2_PACKAGE_LCMS2
	select BR2_PACKAGE_QPDF
	help
	  This package provides the libcupsfilters library, which in its
	  2.x version contains all the code of the filters of the former
	  cups-filters package as library functions, the so-called
	  filter functions.

	  https://github.com/OpenPrinting/libcupsfilters

comment "libcupsfilters needs a toolchain w/ C++ and dynamic library, gcc >= 5"
	depends on BR2_USE_MMU
	depends on BR2_TOOLCHAIN_HAS_ATOMIC
	depends on !BR2_INSTALL_LIBSTDCPP || \
		BR2_STATIC_LIBS || !BR2_TOOLCHAIN_GCC_AT_LEAST_5
```

## package/libppd/Config.in
```kconfig
config BR2_PACKAGE_LIBPPD
	bool "libppd"
	# needs fork()
	depends on BR2_USE_MMU
	depends on BR2_INSTALL_LIBSTDCPP # libcupsfilters -> qpdf
	depends on !BR2_STATIC_LIBS
	depends on BR2_PACKAGE_CUPS
	depends on BR2_TOOLCHAIN_GCC_AT_LEAST_5 # libcupsfilters -> qpdf
	depends on BR2_TOOLCHAIN_HAS_ATOMIC # libcupsfilters -> qpdf
	select BR2_PACKAGE_LIBCUPSFILTERS
	help
	  To avoid re-writing support for an obsolete format from
	  scratch, only for retro-fitting legacy printer drivers
	  we have created this package, libppd, the legacy support
	  library for PPD files.

	  https://github.com/OpenPrinting/libppd

comment "libppd needs a toolchain w/ C++ and dynamic library, gcc >= 5"
	depends on BR2_USE_MMU
	depends on BR2_TOOLCHAIN_HAS_ATOMIC
	depends on !BR2_INSTALL_LIBSTDCPP || \
		BR2_STATIC_LIBS || !BR2_TOOLCHAIN_GCC_AT_LEAST_5
```

## package/lilv/Config.in
```kconfig
config BR2_PACKAGE_LILV
	bool "lilv"
	select BR2_PACKAGE_LV2
	select BR2_PACKAGE_SERD
	select BR2_PACKAGE_SORD
	select BR2_PACKAGE_SRATOM
	help
	  Lilv is a C library to make the use of LV2 plugins as simple
	  as possible for applications.

	  https://drobilla.net/software/lilv.html
```

## package/lua-std-debug/Config.in
```kconfig
config BR2_PACKAGE_LUA_STD_DEBUG
	bool "lua-std-debug"
	depends on BR2_PACKAGE_HAS_LUAINTERPRETER
	help
	  Manage an overall debug state, and associated hint substates.

	  http://lua-stdlib.github.io/_debug
```

## package/python-aiosqlite/Config.in
```kconfig
config BR2_PACKAGE_PYTHON_AIOSQLITE
	bool "python-aiosqlite"
	select BR2_PACKAGE_PYTHON3_SQLITE # runtime
	help
	  asyncio bridge to the standard sqlite3 module.

	  https://aiosqlite.omnilib.dev/
```

## package/python-build/Config.in
```kconfig
config BR2_PACKAGE_PYTHON_BUILD
	bool "python-build"
	depends on BR2_PACKAGE_PYTHON3
	help
	  A simple, correct PEP517 package builder.

          https://github.com/pypa/build
```

## package/python-cryptography/Config.in
```kconfig
config BR2_PACKAGE_PYTHON_CRYPTOGRAPHY
	bool "python-cryptography"
	depends on BR2_PACKAGE_HOST_RUSTC_TARGET_ARCH_SUPPORTS
	depends on BR2_PACKAGE_PYTHON3
	select BR2_PACKAGE_OPENSSL
	select BR2_PACKAGE_PYTHON_CFFI # runtime
	help
	  cryptography is a package designed to expose cryptographic
	  primitives and recipes to Python developers.

	  https://cryptography.io

comment "python-cryptography needs a toolchain w/ rust"
	depends on !BR2_PACKAGE_HOST_RUSTC_TARGET_ARCH_SUPPORTS
	depends on BR2_PACKAGE_PYTHON3
```

## package/python-installer/Config.in
```kconfig
config BR2_PACKAGE_PYTHON_INSTALLER
	bool "python-installer"
	depends on BR2_PACKAGE_PYTHON3
	help
          This is a low-level library for installing a Python
          package from a wheel distribution. It provides basic
          functionality and abstractions for handling wheels and
          installing packages from wheels.

          https://github.com/pradyunsg/installer
```

## package/python-keyring/Config.in
```kconfig
config BR2_PACKAGE_PYTHON_KEYRING
	bool "python-keyring"
	depends on BR2_PACKAGE_HOST_RUSTC_TARGET_ARCH_SUPPORTS # python-secretstorage -> python-cryptography
	depends on BR2_PACKAGE_PYTHON3
	select BR2_PACKAGE_PYTHON_ENTRYPOINTS # runtime
	select BR2_PACKAGE_PYTHON_SECRETSTORAGE # runtime
	help
	  The Python keyring lib provides a easy way to access the
	  system keyring service from Python.

	  https://pypi.python.org/pypi/keyring

comment "python-keyring needs a toolchain w/ rust"
	depends on !BR2_PACKAGE_HOST_RUSTC_TARGET_ARCH_SUPPORTS
	depends on BR2_PACKAGE_PYTHON3
```

## package/python-pep517/Config.in
```kconfig
config BR2_PACKAGE_PYTHON_PEP517
	bool "python-pep517"
	depends on BR2_PACKAGE_PYTHON3
	help
	  his package contains wrappers around the hooks
          specified by PEP 517 and PEP 660.

          https://github.com/pypa/pep517
```

## package/python-pysftp/Config.in
```kconfig
config BR2_PACKAGE_PYTHON_PYSFTP
	bool "python-pysftp"
	depends on BR2_PACKAGE_HOST_RUSTC_TARGET_ARCH_SUPPORTS # python-paramiko -> python-cryptography
	depends on BR2_PACKAGE_PYTHON3 # python-paramiko -> python-cryptography
	select BR2_PACKAGE_PYTHON_PARAMIKO # runtime
	help
	  A friendly face on SFTP.

	  https://bitbucket.org/dundeemt/pysftp

comment "python-pysftp needs a toolchain w/ rust"
	depends on !BR2_PACKAGE_HOST_RUSTC_TARGET_ARCH_SUPPORTS
	depends on BR2_PACKAGE_PYTHON3
```

## package/python-secretstorage/Config.in
```kconfig
config BR2_PACKAGE_PYTHON_SECRETSTORAGE
	bool "python-secretstorage"
	depends on BR2_PACKAGE_HOST_RUSTC_TARGET_ARCH_SUPPORTS # python-cryptography
	depends on BR2_PACKAGE_PYTHON3
	select BR2_PACKAGE_PYTHON_CRYPTOGRAPHY # runtime
	help
	  Python bindings to FreeDesktop.org Secret Service API.

	  https://github.com/mitya57/secretstorage

comment "python-secretstorage needs a toolchain w/ rust"
	depends on !BR2_PACKAGE_HOST_RUSTC_TARGET_ARCH_SUPPORTS
	depends on BR2_PACKAGE_PYTHON3
```

## package/qt5/qt5location-mapboxgl/Config.in
```kconfig
# Not user-selectable, it is only needed to be copied
# into the qt5location source tree.
config BR2_PACKAGE_QT5LOCATION_MAPBOXGL
	bool
```

## package/ruy/Config.in
```kconfig
config BR2_PACKAGE_RUY
	bool "ruy"
	depends on BR2_INSTALL_LIBSTDCPP
	depends on BR2_TOOLCHAIN_GCC_AT_LEAST_4_9 # C++14
	select BR2_PACKAGE_CPUINFO
	help
	  Ruy is a matrix multiplication library. Its focus is to cover
	  the matrix multiplication needs of neural network inference
	  engines. Its initial user has been TensorFlow Lite, where it
	  is used by default on the ARM CPU architecture.

	  https://github.com/google/ruy

comment "ruy needs a toolchain w/ C++14"
	depends on !BR2_INSTALL_LIBSTDCPP || \
		!BR2_TOOLCHAIN_GCC_AT_LEAST_4_9
```
